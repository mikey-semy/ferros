/* Линкер-скрипт пользовательской программы (M5c1, база обновлена в M5c2).
 *
 * Единственное, что нам тут реально нужно, — фиксированная база загрузки
 * 0x7F80_0000_0000: это L4-слот 255 (нижняя каноническая половина, у её верхнего края),
 * заведомо свободный у нашего «низкого» ядра, поэтому в адресном пространстве процесса он
 * приватный. Раскладку сегментов оставляем на усмотрение линкера: наш загрузчик в ядре
 * корректно маппит любые PT_LOAD (в т.ч. делящие одну страницу).
 *
 * Секции `.l*` (`.ltext`/`.lrodata`/`.ldata`/`.lbss`) — это код/данные модели `large`
 * (`clang -mcmodel=large` для C-программ, M9g; их база высокая, и 32-битные релокации до неё не
 * достают). Размещаем их ЯВНО рядом с обычными секциями, а не полагаемся на авто-раскладку
 * «сиротских» секций линкером — так раскладка стабильна между версиями линкера. У Rust-программ
 * этих секций нет, шаблоны просто ничего не матчат.
 */
ENTRY(_start)

SECTIONS {
    . = 0x7F8000000000;

    .text : { *(.text .text.*) *(.ltext .ltext.*) }
    .rodata : { *(.rodata .rodata.*) *(.lrodata .lrodata.*) }
    .data : { *(.data .data.*) *(.ldata .ldata.*) }
    .bss : { *(.bss .bss.*) *(.lbss .lbss.*) }

    /DISCARD/ : { *(.eh_frame) *(.eh_frame_hdr) *(.note .note.*) *(.comment) }
}
